## os/board/zingx/zingx-init/Config.in
```kconfig
config BR2_PACKAGE_ZINGX_INIT
	bool "zingx init scripts"
	default y
	help
	  Boot-time init scripts and profile for the Zingx USB appliance.
```

## os/configs/zingx_x86_64_defconfig
```kconfig
BR2_x86_64=y
BR2_TOOLCHAIN_BUILDROOT_MUSL=y

# Host tools for image assembly
BR2_PACKAGE_HOST_GENIMAGE=y

# Kernel
BR2_LINUX_KERNEL=y
BR2_LINUX_KERNEL_LATEST_VERSION=y
BR2_LINUX_KERNEL_CONFIG_FRAGMENT_FILES="$(BR2_EXTERNAL_ZINGX_PATH)/board/zingx/linux.fragment"
BR2_LINUX_KERNEL_INSTALL=y

# Root filesystem
BR2_TARGET_ROOTFS_SQUASHFS=y
BR2_TARGET_ROOTFS_SQUASHFS4_XZ=y
BR2_TARGET_ROOTFS_INITRAMFS=y
BR2_TARGET_ROOTFS_INITRAMFS_OVERLAY="$(BR2_EXTERNAL_ZINGX_PATH)/board/zingx/initramfs"

BR2_ROOTFS_OVERLAY="$(BR2_EXTERNAL_ZINGX_PATH)/board/zingx/rootfs_overlay"
BR2_ROOTFS_POST_IMAGE_SCRIPT="$(BR2_EXTERNAL_ZINGX_PATH)/board/zingx/post-image.sh"

# Bootloader
BR2_TARGET_GRUB2=y
BR2_TARGET_GRUB2_I386_PC=y
BR2_TARGET_GRUB2_I386_EFI=y
BR2_TARGET_GRUB2_X86_64_EFI=y

# Init / shell
BR2_INIT_BUSYBOX=y
BR2_SYSTEM_DHCP="eth0"
BR2_TARGET_GENERIC_HOSTNAME="zingx"
BR2_TARGET_GENERIC_ISSUE="Welcome to Zingx"
BR2_TARGET_GENERIC_GETTY=y
BR2_TARGET_GENERIC_GETTY_PORT="tty1"
BR2_TARGET_GENERIC_GETTY_OPTIONS="-n -l /bin/login"
BR2_TARGET_GENERIC_GETTY_LOGIN="root"
BR2_TARGET_GENERIC_REMOUNT_ROOTFS_RW=y

# Core packages
BR2_PACKAGE_BUSYBOX=y
BR2_PACKAGE_BUSYBOX_SHOW_OTHERS=y
BR2_PACKAGE_NANO=y
BR2_PACKAGE_BASH=y
BR2_PACKAGE_COREUTILS=y
BR2_PACKAGE_UTIL_LINUX=y
BR2_PACKAGE_UTIL_LINUX_BINARIES=y
BR2_PACKAGE_E2FSPROGS=y
BR2_PACKAGE_DOSFSTOOLS=y
BR2_PACKAGE_EXFATPROGS=y
BR2_PACKAGE_CRYPTSETUP=y
BR2_PACKAGE_LVM2=y
BR2_PACKAGE_CA_CERTIFICATES=y
BR2_PACKAGE_CURL=y
BR2_PACKAGE_WPA_SUPPLICANT=y
BR2_PACKAGE_WPA_SUPPLICANT_CLI=y
BR2_PACKAGE_WPA_SUPPLICANT_PASSPHRASE=y
BR2_PACKAGE_DHCPCD=y
BR2_PACKAGE_KMOD=y
BR2_PACKAGE_PCIUTILS=y
BR2_PACKAGE_USBUTILS=y
# Zingx
BR2_PACKAGE_ZINGX_INIT=y

# Quiet boot (kernel cmdline set in post-image grub.cfg)
BR2_LINUX_KERNEL_CUSTOM_CMDLINE="quiet loglevel=0"
```
